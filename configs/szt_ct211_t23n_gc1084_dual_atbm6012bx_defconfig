## configs/szt_ct211_t23n_gc1084_dual_atbm6012bx_defconfig
```kconfig
# NAME: SZT CT211 (T23N, GC1084, ATBM6012X)
# FRAG: soc-xburst1 toolchain-xburst1 ccache brand rootfs kernel system target uboot ssl
BR2_PACKAGE_WIFI=y
BR2_PACKAGE_WIFI_ATBM6012BX=y
BR2_SOC_INGENIC_T23N=y

BR2_SENSOR_GC1084=y
BR2_SENSOR_1_GC1084S0=y
#BR2_SENSOR_2_GC1084=y
BR2_SENSOR_PARAMS="shvflip=1"
#BR2_THINGINO_IMAGE_SENSOR_QTY_2=y
#BR2_ISP_CONFIG_HZ=10
#BR2_ISP_CONFIG_HZ_VALUE=10

BR2_ISP_CLK_200MHZ=y
# BR2_ISP_DIRECT_MODE_2=y
# BR2_ISP_PARAMS=
BR2_PACKAGE_THINGINO_KOPT_MMC0=y
BR2_PACKAGE_THINGINO_KOPT_MMC0_PB_4BIT=y
BR2_THINGINO_AUDIO=y
BR2_THINGINO_BUTTON=y
BR2_THINGINO_MOTORS=y
BR2_THINGINO_PWM_ENABLE=y
BR2_THINGINO_SDCARD=y
FLASH_SIZE_8=y
# FLASH_SIZE_16=y
BR2_THINGINO_NFS="/mnt/nfs"
```
